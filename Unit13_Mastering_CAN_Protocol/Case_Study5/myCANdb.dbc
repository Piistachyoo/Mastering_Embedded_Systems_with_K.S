VERSION ""

NS_ :

BS_:

BU_: ECU1_Accelerator ECU2_SpeedSensor

BO_ 939 Speed_VAL_message: 1 ECU2_SpeedSensor
 SG_ Speed : 0|8@1+ (1,0) [0|255] ""  ECU1_Accelerator

BO_ 48 Accelerator_CMD_message: 1 ECU1_Accelerator
 SG_ Acceleration_ON : 0|8@1+ (1,0) [0|1] ""  ECU2_SpeedSensor
